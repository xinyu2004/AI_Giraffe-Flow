AUTOSAR XML (schema 4.0)
package /DemoPkg
  sender receiver interface EgoMotion
  sender receiver interface UssZones
  impl type EgoMotion
  impl type UssZones
  app type VehicleSpeed
